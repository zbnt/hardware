/*
	This Source Code Form is subject to the terms of the Mozilla Public
	License, v. 2.0. If a copy of the MPL was not distributed with this
	file, You can obtain one at https://mozilla.org/MPL/2.0/.
*/

/dts-v1/;

/ {
	#address-cells = <1>;
	#size-cells = <1>;
	compatible = "zbnt,NetFPGA_1G_CML", "simple-bus";

	prc@1000 {
		compatible = "zbnt,pr-controller";
		reg = <0x00001000 0x1000>;

		zbnt,bitstreams = "dual_detector", "dual_tgen_detector", "dual_tgen_latency", "quad_tgen";
	};

	dma@2000 {
		compatible = "zbnt,message-dma";
		reg = <0x00002000 0x1000>;
	};
};
